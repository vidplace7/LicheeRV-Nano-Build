## buildroot/package/meshtasticd/Config.in
```kconfig
config BR2_PACKAGE_MESHTASTICD
	bool "meshtasticd"
	help
	  meshtasticd portduino
```

## buildroot/package/python-platformio/Config.in
```kconfig
config BR2_PACKAGE_PYTHON_PLATFORMIO
	bool "python-platformio"
	help
	  PlatformIO IDE

	  https://platformio.org/
```
